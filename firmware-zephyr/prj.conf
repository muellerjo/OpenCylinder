## CMakeLists.txt
```
# OpenCylinder firmware — Zephyr / nRF Connect SDK (production path, nRF54L15).
# Milestone M1 skeleton: banner + ST25R3916 detection on I2C. The portable
# libraries (../firmware/lib/*) and ST RFAL follow in M1/M2.
cmake_minimum_required(VERSION 3.20.0)
find_package(Zephyr REQUIRED HINTS $ENV{ZEPHYR_BASE})
project(opencylinder)

file(READ ${CMAKE_CURRENT_SOURCE_DIR}/VERSION OC_FW_VERSION)
string(STRIP "${OC_FW_VERSION}" OC_FW_VERSION)
execute_process(COMMAND git describe --tags --match "fw-v*" --always --dirty
                WORKING_DIRECTORY ${CMAKE_CURRENT_SOURCE_DIR}
                OUTPUT_VARIABLE OC_FW_GIT OUTPUT_STRIP_TRAILING_WHITESPACE ERROR_QUIET)
target_compile_definitions(app PRIVATE
    FW_VERSION="${OC_FW_VERSION}" FW_GIT="${OC_FW_GIT}"
    OC_VARIANT_OFFLINE=1 OC_VARIANT_NAME="offline" OC_BOARD_NAME="xiao-nrf54l15")

target_sources(app PRIVATE src/main.c)
```

## prj.conf
```kconfig
# Offline variant: no radio code compiled in (docs/online-architecture.md).
CONFIG_BT=n
CONFIG_IEEE802154=n
CONFIG_NET_L2_OPENTHREAD=n

# Console over the XIAO's USB serial (on-board SAMD11 bridge)
CONFIG_SERIAL=y
CONFIG_CONSOLE=y
CONFIG_UART_CONSOLE=y
CONFIG_PRINTK=y

# I2C to the ST25R3916 (M5Stack Unit NFC on D4/D5)
CONFIG_I2C=y
CONFIG_GPIO=y
```

## boards/xiao_nrf54l15_nrf54l15_cpuapp.overlay
```dts
/* XIAO nRF54L15: the ST25R3916 unit hangs on the XIAO I2C pins D4 (SDA) /
 * D5 (SCL) — same Grove wiring as on the ESP32-C3 bench.
 * TODO(M1): check the node label of the XIAO I2C bus in Seeed's board
 * definition (platform-seeedboards) — `xiao_i2c` is the usual XIAO label. */
/ {
	aliases {
		nfc-i2c = &xiao_i2c;
	};
};

&xiao_i2c {
	status = "okay";
	clock-frequency = <I2C_BITRATE_FAST>;
};
```

## src/main.c
```c
/* OpenCylinder — Zephyr skeleton for the nRF54L15 (milestone M1).
 * Prints the banner, then looks for the ST25R3916 on I2C and reads its
 * IC identity register. Card detection via ST RFAL comes next.
 * UNTESTED: written before the board and the toolchain were available. */

#include <zephyr/device.h>
#include <zephyr/drivers/i2c.h>
#include <zephyr/kernel.h>
#include <zephyr/sys/printk.h>

#if defined(OC_VARIANT_OFFLINE) && defined(CONFIG_BT)
#error "offline variant must not contain the Bluetooth stack"
#endif

#define ST25R3916_I2C_ADDR    0x50  /* 7-bit address, default */
#define ST25R3916_REG_IC_ID   0x3F  /* IC identity register */
#define ST25R3916_READ_MODE   0x40  /* register read: 0b01 << 6 | address */

static const struct device *const nfc_i2c = DEVICE_DT_GET(DT_ALIAS(nfc_i2c));

int main(void)
{
	k_msleep(1500); /* give the USB serial bridge time to attach */
	printk("OpenCylinder fw %s+%s.%s (%s)\n", FW_VERSION, OC_BOARD_NAME,
	       OC_VARIANT_NAME, FW_GIT);
	printk("Zephyr skeleton (M1): looking for the ST25R3916 on I2C\n");

	if (!device_is_ready(nfc_i2c)) {
		printk("ERROR: I2C bus not ready\n");
		return 0;
	}

	const uint8_t cmd = ST25R3916_READ_MODE | ST25R3916_REG_IC_ID;
	uint8_t id = 0;
	int rc = i2c_write_read(nfc_i2c, ST25R3916_I2C_ADDR, &cmd, 1, &id, 1);
	if (rc != 0) {
		printk("ST25R3916 not found at 0x%02x (rc %d) - check wiring\n",
		       ST25R3916_I2C_ADDR, rc);
	} else {
		/* ic_type in bits 7..3, ic_rev in bits 2..0 */
		printk("ST25R3916 found: IC identity 0x%02x (type %u, rev %u)\n",
		       id, id >> 3, id & 0x07);
	}

	while (1) {
		k_msleep(1000);
	}
	return 0;
}
```
